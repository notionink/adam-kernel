## arch/arm/mach-tegra/malata_smb/Kconfig
```kconfig
if TEGRA_ODM_HARMONY

comment "Malata SMBxxxx platform options"

choice
	prompt "Select smb platform board"
	default SMBA1002
	
config SMBA1011
	bool "SMBA1011"

config SMBA1002
	bool "SMBA1002"

config SMBA1004
	bool "SMBA1004"

config SMBA1006
	bool "SMBA1006"

config SMBA1007
	bool "SMBA1007"

config SMBA8901
	bool "SMBA8902"

config SMBA9701
	bool "SMBA9701"

endchoice

comment "Subboard platform"

choice
	prompt "Select a subboard of SMBA1011"
	depends on SMBA1011
endchoice

choice 
	prompt "Select a subboard of SMBA1002"
	depends on SMBA1002

config 7265C_V20
	bool "Board number: 7265C_V20"

endchoice

choice 
	prompt "Select a client of 7265C_V20"
	depends on 7265C_V20

config CLIENT_FLEX
	bool "Client: flex"
endchoice

choice
	prompt "Select a subboard of SMBA1004"
	depends on SMBA1004

config 7323C_V21
	bool "Board number: 7323C_V21"

endchoice

choice
	prompt "Select a subboard of SMBA1006"
	default 7379Y_V11
	depends on SMBA1006

config 7379Y_V10
	bool "Board number: 7379Y_V10"

config 7379Y_V11
	bool "Board number: 7379Y_V11"

endchoice

choice
	prompt "Select a subboard of SMBA1007"
	depends on SMBA1007

config 7373C_V20
	bool "Board number: 7373C_V20"

endchoice

choice
	prompt "Select a subboard of SMBA8901"
	depends on SMBA8901
endchoice

choice
	prompt "Select a subboard of SMBA9701"
	depends on SMBA9701
endchoice

endif
```

## drivers/switch/Kconfig
```kconfig
menuconfig SWITCH
	tristate "Switch class support"
	help
	  Say Y here to enable switch class support. This allows
	  monitoring switches by userspace via sysfs and uevent.

if SWITCH

config SWITCH_GPIO
	tristate "GPIO Swith support"
	depends on GENERIC_GPIO
	help
	  Say Y here to enable GPIO based switch support.

config SWITCH_H2W
	tristate "H2w Switch support"
	help
	  Say Y here to enable h2w switch.

config SWITCH_DOCK_H2W
	tristate "Dock h2w switch support"
	help
	  Say Y here to enable dock h2w switch.

config SWITCH_DOCK
	tristate "Dock switch support"
	help
	  Say Y here to enable dock switch.

config SWITCH_HDMI
	tristate "HDMI switch support"
	help
	  Say Y here to enable hdmi switch.

endif # SWITCH
```
